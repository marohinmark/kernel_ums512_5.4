// SPDX-License-Identifier: GPL-2.0-only
/*
 * Unisoc UMS512-1h10 boards DTS file
 *
 * Copyright (C) 2024, Unisoc Inc.
 */

/dts-v1/;

#include <dt-bindings/gpio/gpio.h>
#include "ums512.dtsi"
#include "sc2730.dtsi"
#include "sprd-sound-fe-be.dtsi"
#include "ums512-mach.dtsi"
#include "tp/nvt-touchscreen-novatek-nt36xxx-spi.dtsi"
#include "lcd/lcd_td4160_cw_mipi_hd.dtsi"

/ {
	model = "Spreadtrum UMS512-1H10 Soc";

	compatible = "sprd,ums512";

	sprd,sc-id = "ums512 1000 1000";

	aliases {
		serial0 = &uart0;
		serial1 = &uart1;
	};

	memory@80000000 {
		device_type = "memory";
		reg = <0x0 0x80000000 0x0 0x80000000>;
	};

	chosen: chosen {
		stdout-path = "serial1:115200n8";
		bootargs = "earlycon console=ttyS1,115200n8 loop.max_part=7 loglevel=1 init=/init root=/dev/ram0 rw printk.devkmsg=on androidboot.boot_devices=soc/soc:ap-apb/71400000.sdio dummy_hcd.num=0 swiotlb=1 initcall_debug=1 androidboot.init_fatal_panic=true";
	};

	extcon_gpio: extcon-gpio {
		compatible = "linux,extcon-usb-gpio";
		vbus-gpio = <&pmic_eic 0 GPIO_ACTIVE_HIGH>;
	};
};

&mpu {
	status = "okay";
};

&uart0 {
	status = "okay";
};

&uart1 {
	status = "okay";
};

&i2c4 {
	status = "okay";
	clock-frequency = <400000>;

	flash_ic: flash-ic@63 {
		compatible = "sprd,flash-ocp8137";
		reg = <0x63>;
		sprd,flash-ic = <8137>;
		sprd,torch = <1>;
		sprd,preflash = <1>;
		sprd,highlight = <1>;
		sprd,torch-level = <128>;
		sprd,preflash-level = <128>;
		sprd,highlight-level = <128>;
		sprd,lvfm-enable = <1>;
		flash-chip-en-gpios = <&ap_gpio 136 0>;
		flash-torch-en-gpios = <&ap_gpio 139 0>;
		flash-en-gpios = <&ap_gpio 137 0>;
		flash-sync-gpios = <&ap_gpio 138 0>;
	};

	ucp1301_spk: ucp1301@58 {
		compatible = "unisoc,ucp1301-spk";
		reg = <0x58>;
		reset-gpios = <&ap_gpio 134 GPIO_ACTIVE_HIGH>;
		#sound-dai-cells = <1>;
	};
};

&spi0 {
	/*used for fingerprint sensor*/
	status = "okay";
};

spi@800000 {
	#address-cells = <0x1>;
	#size-cells = <0x0>;
	clock-names = "enable", "spi", "source";
	clocks = <0x5 0x5 0x6 0xa 0x8 0x3>;
	compatible = "sprd,ums512-spi", "sprd,sc9860-spi";
	interrupts = <0x0 0x5 0x4>;
	phandle = <0xe2>;
	reg = <0x800000 0x1000>;
	status = "okay";
};

spi@900000 {
	#address-cells = <0x1>;
	#size-cells = <0x0>;
	clock-names = "enable", "spi", "source";
	clocks = <0x5 0x6 0x6 0xb 0x8 0x3>;
	compatible = "sprd,ums512-spi", "sprd,sc9860-spi";
	interrupts = <0x0 0x6 0x4>;
	phandle = <0xe3>;
	reg = <0x900000 0x1000>;
	status = "disabled";
};

spi@a00000 {
	#address-cells = <0x1>;
	#size-cells = <0x0>;
	clock-names = "enable", "spi", "source";
	clocks = <0x5 0x7 0x6 0xc 0x8 0x3>;
	compatible = "sprd,ums512-spi", "sprd,sc9860-spi";
	interrupts = <0x0 0x7 0x4>;
	phandle = <0xe4>;
	reg = <0xa00000 0x1000>;
	status = "ok";

	adaptive-touchscreen@0 {
		compatible = "adaptive-touchscreen";
		controller = "nt36xxx,NT36XXX";
		novatek,spi-rd-fast-addr = <0x3f310>;
		novatek,swrst-n8-addr = <0x3f0fe>;
                phandle = <0xe5>;
		reg = <0x0>;
		spi-max-frequency = <0x927c00>;
		status = "ok";
		touch,irq-gpio = <0x7 0x90 0x0>;
		touch,reset-gpio = <0x7 0x91 0x0>;
		tp_avdd_supply = "1850";
		tp_esd_check = <0x0>;
		tp_gesture_status = <0x1>;
		tp_ic_num = <0x2>;
		tp_max_x = <0x2d0>;
		tp_max_y = <0x668>;
		tp_point_max = <0x5>;
		tp_ps_status = <0x0>;
		tp_sensorhub_status = <0x0>;
		tp_upgrade_switch = <0x1>;

		ats_nt36xxx {
			phandle = <0xe6>;
			tp_upgrade_fw = <0x1>;
			tp_vendor_id = <0x2020>;
			tp_vendor_num = <0x1>;
		};

		ats_omnivision {
			phandle = <0xe7>;
			tp_upgrade_fw = <0x1>;
			tp_vendor_id = <0x130>;
			tp_vendor_num = <0x1>;
		};

		private-data {
			a8 = [5a];
		};
	};
};

spi@b00000 {
	#address-cells = <0x1>;
	#size-cells = <0x0>;
	clock-names = "enable", "spi", "source";
	clocks = <0x5 0x8 0x6 0xd 0x8 0x3>;
	compatible = "sprd,ums512-spi", "sprd,sc9860-spi";
	interrupts = <0x0 0x8 0x4>;
	phandle = <0xe8>;
	reg = <0xb00000 0x1000>;
	status = "disabled";
};

&sdio0 {
	bus-width = <4>;
	no-sdio;
	no-mmc;
	status = "okay";
};

&sdio1 {
	bus-width = <4>;
	no-sd;
	no-mmc;
	status = "okay";
};

&sdio3 {
	bus-width = <8>;
	non-removable;
	no-sdio;
	no-sd;
	cap-mmc-hw-reset;
	status = "okay";
};

&dpu {
	status = "okay";
};

&mm_domain {
	status = "okay";
};

&iommu_dispc {
	status = "okay";
};

&dcam {
	status = "okay";
};

&iommu_dcam {
	status = "okay";
};

&isp {
	status = "okay";
};

&iommu_isp {
	status = "okay";
};

&cpp {
	status = "okay";
};

&iommu_cpp {
	status = "okay";
};

&csi0 {
	status = "okay";
};

&csi1 {
	status = "okay";
};

&csi2 {
	status = "okay";
};

&iommu_fd {
	status = "okay";
};

dsi@20400000 {
	#address-cells = <0x1>;
	#size-cells = <0x0>;		
        clock-names = "clk_ap_ahb_dsi_eb";
	clocks = <0x9 0x0>;
	compatible = "sprd,sharkl5pro-dsi-host";
	interrupts = <0x0 0x1e 0x4 0x0 0x1f 0x4>;
	phandle = <0xfa>;
	reg = <0x0 0x20400000 0x0 0x1000>;
	reset-syscon = <0xa 0x4 0x1>;
	status = "okay";

	panel {
		#address-cells = <0x1>;
		#size-cells = <0x0>;
		compatible = "sprd,generic-mipi-panel";
		phandle = <0xfb>;
		reg = <0x0>;

		port@1 {
			reg = <0x1>;

			endpoint {
				phandle = <0x26>;
				remote-endpoint = <0x25>;
			};
		};
	};

	ports {
		#address-cells = <0x1>;
		#size-cells = <0x0>;

		port@0 {
			reg = <0x0>;

			endpoint {
				phandle = <0x27>;
				remote-endpoint = <0x23>;
			};
		};

		port@1 {
			reg = <0x1>;

			endpoint {
				phandle = <0x22>;
				remote-endpoint = <0x24>;
			};
		};
	};
};

&dphy {
	status = "okay";
};

&vsp {
	status = "okay";
};

&vsp_pd {
	status = "okay";
};

&iommu_vsp {
	status = "okay";
};

&iommu_vdsp_msti {
	status = "okay";
};

&iommu_vdsp_mstd {
	status = "okay";
};

&iommu_vdsp_idma {
	status = "okay";
};

&iommu_vdsp_vdma {
	status = "okay";
};

&vdsp {
	status = "okay";
};

&jpg {
	status = "okay";
};

&iommu_jpg {
	status = "okay";
};

&vddldo0 {
	regulator-always-on;
};

&vddemmccore {
	regulator-always-on;
};

&sprd_headset {
	status = "okay";
	extcon = <&pmic_typec>;
	mic-gpios = <&ap_gpio 16 GPIO_ACTIVE_HIGH>;
	lr-gpios = <&ap_gpio 15 GPIO_ACTIVE_HIGH>;
	sprd,3pole-adc-threshold = <112>;
};

&sprd_audio_codec_ana {
	status = "okay";
	hp-use-inter-pa = <1>;
	fixed-sample-rate = <48000 48000 48000>;
	digital-codec = <&sprd_audio_codec_dig>;
};

&sound_vbc_v4_sprd_codec {
	status = "okay";
	sprd-audio-card,routing =
		"HPMIC Pin", "HP Mic Jack",
		"MIC Pin", "Mic Jack",
		"MIC2 Pin", "Aux Mic Jack",
		"HeadPhone Jack", "HP Pin",
		"Ext Spk", "SPK Pin",
		"UCP1301 SPK ON", "SPK Pin",
		"Ext Spk", "UCP1301 SPK",
		"DMIC Pin", "DMic Jack",
		"DMIC1 Pin", "DMic1 Jack",
		"Ext Ear", "EAR Pin";

	/* 35: ucp1301 normal ap01 */
	sprd-audio-card,dai-link@53 {
		ignore-suspend = <1>;
		link-name = "BE_NORMAL_AP01_UCPSPK";
		stream-name = "BE_ST_NORMAL_AP01_UCPSPK";
		no-pcm = <1>;
		dpcm-playback = <1>;
		be-id = <0>;
		dai-format = "i2s";
		plat {
			sound-dai = <&sprd_route_pcm>;
		};
		cpu {
			sound-dai = <&vbc_v4 3>;
		};
		codec {
			sound-dai = <&ucp1301_spk 0>;
		};
	};

	/*
	 * node 54 and node 55 (index 36 and 37) are reserved for
	 * "ucp1301-spk2" and "ucp1301-rcv"
	 * nodes from 56 to 67 (index from 38 to 49) are used by HIFI
	 */
};
